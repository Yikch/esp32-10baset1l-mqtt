## components/app_config/Kconfig
```kconfig
menu "Nodo sensor SPE - Configuracion"

    comment "Interfaz de red - IP estatica (F-02)"

    config NODE_STATIC_IP
        string "Direccion IP estatica del nodo"
        default "192.168.10.1"
        help
            Direccion IP del nodo en el enlace punto a punto 10BASE-T1L.
            No se usa DHCP.

    config NODE_NETMASK
        string "Mascara de subred"
        default "255.255.255.0"

    config NODE_GATEWAY
        string "Puerta de enlace (gateway)"
        default "192.168.10.2"
        help
            IP del gateway remoto al otro extremo del enlace SPE.

    comment "Identidad del nodo"

    config NODE_ID
        string "Identificador del nodo"
        default "esp32_01"
        help
            Identificador unico del nodo. Se incrusta en los payloads de
            estado publicados en el topic de estado: {"node":"<id>",...}
            (requisitos F-10, F-11 y F-12).

    comment "Cliente MQTT (F-05)"

    config NODE_MQTT_BROKER_URI
        string "URI del broker MQTT"
        default "mqtt://192.168.10.2:1883"
        help
            URI del broker MQTT. Esquema mqtt:// (texto plano, puerto 1883).

    config NODE_MQTT_USERNAME
        string "Usuario MQTT (token de dispositivo)"
        default ""
        help
            Nombre de usuario MQTT. Dejar vacio si el broker no requiere
            autenticacion. Para publicar directamente en ThingsBoard, poner
            aqui el access token del dispositivo (la contrasena y el client-id
            se dejan vacios).

    config NODE_MQTT_TOPIC
        string "Topic de publicacion de datos"
        default "v1/spe/sensor/data"
        help
            Topic de publicacion de mediciones. Contrato con el gateway:
            "v1/spe/sensor/data". Para publicar directamente en ThingsBoard
            usar en su lugar "v1/devices/me/telemetry".

    config NODE_MQTT_STATUS_TOPIC
        string "Topic de estado (presencia / LWT)"
        default "v1/spe/sensor/status"
        help
            Topic donde se publican el estado ONLINE/OFFLINE del nodo y el
            Last Will Testament (retain=true). Contrato con el gateway:
            "v1/spe/sensor/status" (requisitos F-10, F-11 y F-12).

    config NODE_MQTT_CMD_TOPIC
        string "Topic de comandos administrativos"
        default "v1/spe/sensor/cmd"
        help
            Topic al que se suscribe el nodo para recibir comandos
            administrativos. Un payload que contenga "reboot" o "shutdown"
            dispara un cierre ordenado (OFFLINE/shutdown) seguido de reinicio
            (requisito F-12). Dejar vacio para desactivar la suscripcion.

    config NODE_MQTT_QOS
        int "QoS de publicacion"
        default 1
        range 0 2
        help
            Calidad de servicio MQTT. El contrato con el gateway fija QoS 1.

    config NODE_MQTT_KEEPALIVE_S
        int "Keepalive MQTT (s)"
        default 20
        range 5 20
        help
            Periodo de keepalive del cliente MQTT, en segundos. El broker debe
            detectar la caida del nodo en menos de 30 s (~1,5 x keepalive), por
            lo que debe ser <= 20 s (requisito F-13).

    comment "Muestreo del sensor (F-06)"

    config NODE_SAMPLE_PERIOD_MS
        int "Periodo de muestreo (ms)"
        default 2000
        range 100 30000
        help
            Periodo entre lecturas del sensor de CO. Por defecto 2 s,
            maximo 30 s.

endmenu
```

## components/co_sensor/Kconfig
```kconfig
# Driver de sensores de gas ANALOGICOS (ADC).
#
# PENDIENTE DE COMPROBACION Y PRUEBA: no se probaran sensores ADC sobre la placa
# SparkFun MicroMod ESP32 por limitaciones de hardware (el banco usa el sensor
# I2C por Qwiic, componente i2c_sensor). Estas opciones se conservan para un
# futuro nodo con sensor analogico y requieren calibracion con gas patron.
menu "Nodo sensor SPE - Sensor de gas ADC (co_sensor, pendiente)"

    config CO_SENSOR_ADC_CHANNEL
        int "Canal ADC1 de la salida del sensor"
        default 6
        range 0 7
        help
            Canal de la unidad ADC1 conectado a la salida analogica del sensor.
            El ADC1 del ESP32 tiene 8 canales (0-7): 0=GPIO36, 3=GPIO39,
            4=GPIO32, 5=GPIO33, 6=GPIO34, 7=GPIO35.

    config CO_SENSOR_ADC_SAMPLES
        int "Muestras ADC a promediar por lectura"
        default 16
        range 1 256
        help
            Numero de conversiones ADC promediadas en cada lectura para
            atenuar el ruido.

    config CO_SENSOR_CLEAN_AIR_MV
        int "Tension en aire limpio (mV)"
        default 400
        help
            Tension de salida del sensor en aire limpio (~0 ppm de CO).
            Punto de calibracion: requiere ajuste con el sensor real.

    config CO_SENSOR_MV_PER_PPM
        int "Sensibilidad (micro-voltios por ppm)"
        default 1500
        help
            Pendiente de la recta tension-concentracion, en uV/ppm.
            Conversion provisional lineal: requiere calibracion con gas patron.

endmenu
```

## components/eth_adin1110/Kconfig
```kconfig
menu "Interfaz Ethernet SPE - ADIN1110 (10BASE-T1L)"

    comment "Bus SPI (SparkFun MicroMod ESP32: VSPI del conector M.2)"

    config ETH_ADIN1110_SPI_HOST
        int "Host SPI (1 = SPI2/HSPI, 2 = SPI3/VSPI)"
        default 2
        range 1 2
        help
            Controlador SPI maestro. Los pines por defecto (18/23/19/5) son los
            nativos IOMUX de VSPI (SPI3_HOST = 2).

    config ETH_ADIN1110_SCLK_GPIO
        int "GPIO SCLK"
        default 18

    config ETH_ADIN1110_MOSI_GPIO
        int "GPIO MOSI (COPI / SDO)"
        default 23

    config ETH_ADIN1110_MISO_GPIO
        int "GPIO MISO (CIPO / SDI)"
        default 19

    config ETH_ADIN1110_CS_GPIO
        int "GPIO CS (chip select, SPI_CS del M.2)"
        default 5

    config ETH_ADIN1110_SPI_HZ
        int "Frecuencia de reloj SPI (Hz)"
        default 15000000
        range 1000000 25000000
        help
            Reloj SPI para el modo OPEN Alliance TC6. Conservador al inicio; se
            puede subir tras validar el enlace con iperf.

    comment "Lineas de control"

    config ETH_ADIN1110_INT_GPIO
        int "GPIO INT (recepcion por interrupcion; -1 = solo sondeo)"
        default 12
        range -1 39
        help
            Pin de interrupcion del ADIN1110 (en la function board SparkFun es
            F0/INT = GPIO12). La tarea de servicio recibe tramas cuando se
            activa. Con -1, se recurre solo al sondeo periodico (mayor latencia).

    config ETH_ADIN1110_RESET_GPIO
        int "GPIO RESET (-1 = reset por software via SPI)"
        default -1
        range -1 39
        help
            Pin de RESET hardware. Con -1, el driver hace reset por software.

    config ETH_ADIN1110_POLL_MS
        int "Periodo de servicio/sondeo del enlace (ms)"
        default 1000
        range 50 5000
        help
            Cada cuanto, como maximo, la tarea de servicio revisa el enlace y
            drena la FIFO de recepcion aunque no llegue interrupcion.

endmenu
```

## components/i2c_sensor/Kconfig
```kconfig
menu "Nodo sensor SPE - Sensores I2C"

    comment "Bus I2C compartido (Qwiic)"

    config I2C_SENSOR_PORT
        int "Puerto I2C maestro"
        default 0
        range 0 1
        help
            Numero de puerto del controlador I2C maestro del ESP32 (0 o 1).
            Todos los sensores I2C comparten este unico bus.

    config I2C_SENSOR_SDA_GPIO
        int "GPIO SDA (Qwiic)"
        default 21
        help
            GPIO de la linea SDA. En el SparkFun MicroMod ESP32 el bus I2C
            primario (conector Qwiic de la placa Main) es SDA=GPIO21.

    config I2C_SENSOR_SCL_GPIO
        int "GPIO SCL (Qwiic)"
        default 22
        help
            GPIO de la linea SCL. En el SparkFun MicroMod ESP32 el bus I2C
            primario (conector Qwiic de la placa Main) es SCL=GPIO22.

    config I2C_SENSOR_FREQ_HZ
        int "Frecuencia de reloj I2C (Hz)"
        default 100000
        range 10000 400000
        help
            Frecuencia del reloj SCL del bus compartido. Qwiic admite hasta
            400 kHz; 100 kHz es un valor conservador y robusto.

    comment "Sensores del bus (habilitar los presentes; direcciones distintas)"

    config I2C_SENSOR_SIMULATED_ENABLE
        bool "Sensor simulado (sin hardware)"
        default y
        help
            Driver sin hardware que genera lecturas sinteticas. No usa el bus
            I2C, por lo que el firmware arranca y publica aunque no haya sensores
            conectados. Publica en el campo "CO_LEVEL". Util para validar la app;
            desactivar en el banco con sensores reales.

    config I2C_SENSOR_OXYGEN_ENABLE
        bool "DFRobot Gravity I2C Oxygen Sensor (SEN0322, O2)"
        default n
        help
            Sensor electroquimico de oxigeno (0-25 %vol). Publica en el campo
            "O2" en %vol.

    config I2C_SENSOR_OXYGEN_ADDR
        hex "Direccion I2C del SEN0322 (O2)"
        depends on I2C_SENSOR_OXYGEN_ENABLE
        default 0x70
        range 0x70 0x73
        help
            Direccion I2C del DFRobot SEN0322, seleccionable por DIP (A0/A1)
            entre 0x70 y 0x73. Debe ser distinta de la de los demas sensores
            del bus.

    config I2C_SENSOR_OXYGEN_SAMPLES
        int "Muestras a promediar (O2)"
        depends on I2C_SENSOR_OXYGEN_ENABLE
        default 3
        range 1 32
        help
            Numero de lecturas consecutivas promediadas por medida para atenuar
            el ruido.

    config I2C_SENSOR_OZONE_ENABLE
        bool "DFRobot Gravity I2C Ozone Sensor (SEN0321, O3)"
        default n
        help
            Sensor electroquimico de ozono (0-10 ppm, resolucion 0,01 ppm segun
            datasheet). Publica en el campo "O3" en ppb.

    config I2C_SENSOR_OZONE_ADDR
        hex "Direccion I2C del SEN0321 (O3)"
        depends on I2C_SENSOR_OZONE_ENABLE
        default 0x73
        range 0x70 0x73
        help
            Direccion I2C del DFRobot SEN0321, seleccionable por el DIP A1/A0
            (2 bits -> 0x70..0x73). En este modulo las lineas estan en pull-up:
            un interruptor en OFF = bit a 1, por lo que con AMBOS interruptores
            en OFF la direccion es 0x73 (verificado, valor por defecto); pasar un
            bit a ON la baja hacia 0x70. Debe ser distinta de la de los demas
            sensores del bus.

    config I2C_SENSOR_OZONE_SAMPLES
        int "Muestras a promediar (O3)"
        depends on I2C_SENSOR_OZONE_ENABLE
        default 4
        range 1 100
        help
            Numero de lecturas consecutivas promediadas por medida para atenuar
            el ruido.

    config I2C_SENSOR_MULTIGAS_ENABLE
        bool "DFRobot Gravity Multi-Gas Sensor (PLANTILLA, sin portar)"
        default n
        help
            Driver de ejemplo (scaffold) para anadir un sensor multigas al bus.
            El protocolo no esta portado: si se habilita, el sensor queda
            inactivo (read devuelve ESP_ERR_NOT_SUPPORTED). Sirve de plantilla
            para integrar un sensor nuevo. Ver drivers/multigas.c.

    config I2C_SENSOR_MULTIGAS_ADDR
        hex "Direccion I2C del MultiGasSensor"
        depends on I2C_SENSOR_MULTIGAS_ENABLE
        default 0x74
        range 0x00 0x7F
        help
            Direccion I2C del modulo MultiGas. Debe ser distinta de la de los
            demas sensores del bus.

endmenu
```

## sdkconfig.defaults
```kconfig
# Flash de 16 MB: el modulo SparkFun MicroMod ESP32 monta una W25Q128 (16 MB).
CONFIG_ESPTOOLPY_FLASHSIZE_16MB=y

#
# El cliente MQTT usa texto plano (mqtt://, puerto 1883), por lo que NO se
# habilita el certificate bundle de mbedTLS (ahorra flash). Si se migra a
# MQTT sobre TLS (mqtts://), volver a anadir:
#   CONFIG_MBEDTLS_CERTIFICATE_BUNDLE=y
#   CONFIG_MBEDTLS_CERTIFICATE_BUNDLE_DEFAULT_FULL=y
```
